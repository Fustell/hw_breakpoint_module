## conf/layer.conf
```bitbake
# We have a conf and classes directory, add to BBPATH
BBPATH .= ":${LAYERDIR}"

# We have recipes-* directories, add to BBFILES
BBFILES += "${LAYERDIR}/recipes-*/*/*.bb \
            ${LAYERDIR}/recipes-*/*/*.bbappend"

BBFILE_COLLECTIONS += "meta-watchpoint-memory"
BBFILE_PATTERN_meta-watchpoint-memory = "^${LAYERDIR}/"
BBFILE_PRIORITY_meta-watchpoint-memory = "6"

LAYERDEPENDS_meta-watchpoint-memory = "core"
LAYERSERIES_COMPAT_meta-watchpoint-memory = "kirkstone"
```
